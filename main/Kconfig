## main/Kconfig
```kconfig
menu "GSM PPPoS configuration"

config GSM_DEBUG
    bool "Enable GSM debugging"
    default y
    help
        Show GSM debug messages

config GSM_TX
    int "UART Output to GSM Module"
    default 21
    range 1 30
    help
	UART Tx pin, connected to GSM Module Rx pin.

config GSM_RX
    int "UART Input from GSM Module"
    default 31
    range 1 38
    help
	UART Rx pin, connected to GSM Module Tx pin.

config GSM_BDRATE
    int "UART Baud rate"
    default 115200
    help
	UART baudrate to comunicate with GSM module

config GSM_INTERNET_USER
    string "Internet User"
	default ""
	help
		Network provider internet user.

config GSM_INTERNET_PASSWORD
    string "Internet password"
	default ""
	help
		Network provider internet password
		
config GSM_APN
    string "Internet APN"
    default "providerAPN"
    help
       Network provider's APN for internet access

config GSM_USE_WIFI_AP
    bool "Start WiFi and AP"
    default n
    help
        Start WiFi as Acces Point and create WebServer task

config GSM_SEND_SMS
    bool "Send SMS message"
    default n
    help
        Send SMS messages during example run

config GSM_SMS_NUMBER
    string "SMS number"
   	depends on GSM_SEND_SMS
    default "+1998765432"
    help
       SMS number for sending messages
       Enter the number in international format (+123999876543)

config GSM_SMS_INTERVAL
    int "SMS message interval"
   	depends on GSM_SEND_SMS
    default 300000
    range 180000 3600000
    help
	Set SMS message interval in mili seconds

endmenu

menu "MQTT Application"

config WIFI_SSID
    string "WiFi SSID"
    default "myssid"
    help
        SSID (network name) for the example to connect to.

config WIFI_PASSWORD
    string "WiFi Password"
    default "mypassword"
    help
        WiFi password (WPA or WPA2) for the example to use.

endmenu

menu "CAN_COLLECTOR_MQTT Configurations"

config MQTT_PROTOCOL_311
    bool "Enable MQTT protocol 3.1.1"
    default y
    help
        If not, this library will use MQTT protocol 3.1

config MQTT_TRANSPORT_SSL
    bool "Enable MQTT over SSL"
    default y
    help
        Enable MQTT transport over SSL with mbedtls

config MQTT_TRANSPORT_WEBSOCKET
    bool "Enable MQTT over Websocket"
    default y
    help
        Enable MQTT transport over Websocket.

config MQTT_TRANSPORT_WEBSOCKET_SECURE
    bool "Enable MQTT over Websocket Secure"
    default y
    depends on MQTT_TRANSPORT_WEBSOCKET
    depends on MQTT_TRANSPORT_SSL
    help
        Enable MQTT transport over Websocket Secure.

config MQTT_USE_CUSTOM_CONFIG
    bool "MQTT Using custom configurations"
    default n
    help
        Custom MQTT configurations.

config MQTT_TCP_DEFAULT_PORT
    int "Default MQTT over TCP port"
    default 1883
    depends on MQTT_USE_CUSTOM_CONFIG
    help
        Default MQTT over TCP port

config MQTT_SSL_DEFAULT_PORT
    int "Default MQTT over SSL port"
    default 8883
    depends on MQTT_USE_CUSTOM_CONFIG
    depends on MQTT_TRANSPORT_SSL
    help
        Default MQTT over SSL port
        
config MQTT_WS_DEFAULT_PORT
    int "Default MQTT over Websocket port"
    default 80
    depends on MQTT_USE_CUSTOM_CONFIG
    depends on MQTT_TRANSPORT_WEBSOCKET
    help
        Default MQTT over Websocket port

config MQTT_WSS_DEFAULT_PORT
    int "Default MQTT over Websocket Secure port"
    default 443
    depends on MQTT_USE_CUSTOM_CONFIG
    depends on MQTT_TRANSPORT_WEBSOCKET
    depends on MQTT_TRANSPORT_WEBSOCKET_SECURE
    help
        Default MQTT over Websocket Secure port

config MQTT_BUFFER_SIZE
    int "Default MQTT Buffer Size"
    default 1024
    depends on MQTT_USE_CUSTOM_CONFIG
    help
        This buffer size using for both transmit and receive

config MQTT_TASK_STACK_SIZE
    int "MQTT task stack size"
    default 6144
    depends on MQTT_USE_CUSTOM_CONFIG
    help
        MQTT task stack size

config MQTT_SERVER_URI
    string "MQTT URI (Address or IP)"
    help
        MQTT URI (Address or IP)

config MQTT_TOPIC
    string "MQTT TOPIC to post"
    help
        MQTT TOPIC to post
		
endmenu
```
